## CMakeLists.txt
```
cmake_minimum_required(VERSION 3.20.0)

set(COMMON ${CMAKE_CURRENT_SOURCE_DIR}/../common)
list(APPEND EXTRA_CONF_FILE ${COMMON}/limits_crypto.conf ${COMMON}/pairing_crypto.conf
    ${CMAKE_CURRENT_SOURCE_DIR}/device_keys.conf)
find_package(Zephyr REQUIRED HINTS $ENV{ZEPHYR_BASE})
project(medsec_hub LANGUAGES C)

set(CORE ${CMAKE_CURRENT_SOURCE_DIR}/../core)
target_sources(app PRIVATE src/main.c src/device_keys.c src/limits_signer.c src/log_verifier.c
    src/pairing.c src/update.c
    ${CORE}/src/alarm.c
    ${CORE}/src/limits_auth.c ${CORE}/src/plx.c ${CORE}/src/security_log.c
    ${COMMON}/src/medsec_crypto.c ${COMMON}/src/pairing_seal.c)
target_include_directories(app PRIVATE ${CORE}/include ${COMMON}/include)
include(${COMMON}/master.cmake)
medsec_master(signing)
medsec_master(pairing)
# The SMP image client includes MCUboot's image headers.
target_link_libraries(app PRIVATE MCUBOOT_BOOTUTIL)
```

## Kconfig
```
# The hub's own options, then Zephyr's.

config HUB_SMP_CLIENT_TRANSPORT
	bool "SMP over the hub's link to the oximeter"
	default y
	select MCUMGR_TRANSPORT_REASSEMBLY
	help
	  src/update.c's SMP transport, which reassembles responses longer than one notification.

source "Kconfig.zephyr"
```

## prj.conf
```kconfig
CONFIG_STD_C17=y
CONFIG_COMPILER_WARNINGS_AS_ERRORS=y

CONFIG_LOG=y
# Log through the shell, which owns the console.
CONFIG_SHELL=y
CONFIG_LOG_BACKEND_UART=n

CONFIG_BT=y
CONFIG_BT_CENTRAL=y
CONFIG_BT_GATT_CLIENT=y
# Lets a subscription find the characteristic's notification switch (its CCC descriptor) itself.
CONFIG_BT_GATT_AUTO_DISCOVER_CCC=y

# A 247-byte ATT MTU, which the hub asks for as soon as it connects: an update goes in big pieces,
# and a signed limits change (21 bytes) in one write. It's the largest that still fits one 251-byte
# link-layer packet.
CONFIG_BT_BUF_ACL_RX_SIZE=251
CONFIG_BT_L2CAP_TX_MTU=247
CONFIG_BT_GATT_AUTO_UPDATE_MTU=y
# Data Length Extension: a whole ATT payload, such as a signed limits change, travels in one
# link-layer packet rather than several. Renode's radio model also needs it on an encrypted link: it
# delivers a packet that arrives while the receiver is still turning around one connection event
# late, and the link never catches up.
CONFIG_BT_CTLR_DATA_LENGTH_MAX=251
CONFIG_BT_BUF_ACL_TX_SIZE=251
# PSA Crypto starts on the main thread, and signing runs on the Bluetooth receive thread.
CONFIG_MAIN_STACK_SIZE=2048
CONFIG_BT_RX_STACK_SIZE=2048

# Pairs by LE Secure Connections only, with the oximeter's out-of-band data (src/pairing.c), and
# keeps the bond. Only in RAM here: the gateway it stands in for would keep it in flash.
CONFIG_BT_SMP=y
CONFIG_BT_SMP_SC_ONLY=y

# Sends the oximeter its updates over SMP (src/update.c), with Zephyr's own client for the image
# and reset commands, which reads MCUboot's image format with MCUboot's utility library.
CONFIG_NET_BUF=y
CONFIG_ZCBOR=y
CONFIG_MCUBOOT_BOOTUTIL_LIB=y
CONFIG_MCUMGR=y
CONFIG_SMP_CLIENT=y
CONFIG_MCUMGR_GRP_IMG_CLIENT=y
CONFIG_MCUMGR_GRP_OS_CLIENT=y
CONFIG_MCUMGR_GRP_OS_CLIENT_RESET=y
```

## device_keys.conf
```kconfig
# HKDF-SHA256, for deriving each oximeter's keys from the backend's masters. The hub and
# hub/tests/limits_signer both use this file.
CONFIG_PSA_WANT_ALG_HKDF=y
CONFIG_PSA_WANT_KEY_TYPE_DERIVE=y
```

## src/device_keys.c
```c
#include "device_keys.h"

#include <psa/crypto.h>
#include <string.h>

/* Each says what its key is for, so the same master can never yield one key for two jobs. They
 * must match tools/provision.py. */
static const char *const labels[] = {
    [DEVICE_KEY_LIMITS] = "medsec limits key",
    [DEVICE_KEY_LOG] = "medsec log key",
    [DEVICE_KEY_PAIRING] = "medsec pairing key",
};
#define LONGEST_LABEL (sizeof "medsec pairing key" - 1u)

bool device_keys_hkdf(const uint8_t *ikm, size_t ikm_length, const uint8_t *salt,
                      size_t salt_length, const uint8_t *info, size_t info_length, uint8_t *out,
                      size_t out_length)
{
    psa_key_derivation_operation_t operation = PSA_KEY_DERIVATION_OPERATION_INIT;
    psa_status_t status = psa_crypto_init();

    /* PSA takes the inputs in this order. An empty salt is RFC 5869's absent one. */
    if (status == PSA_SUCCESS) {
        status = psa_key_derivation_setup(&operation, PSA_ALG_HKDF(PSA_ALG_SHA_256));
    }
    if (status == PSA_SUCCESS) {
        status = psa_key_derivation_input_bytes(&operation, PSA_KEY_DERIVATION_INPUT_SALT, salt,
                                                salt_length);
    }
    if (status == PSA_SUCCESS) {
        status = psa_key_derivation_input_bytes(&operation, PSA_KEY_DERIVATION_INPUT_SECRET, ikm,
                                                ikm_length);
    }
    if (status == PSA_SUCCESS) {
        status = psa_key_derivation_input_bytes(&operation, PSA_KEY_DERIVATION_INPUT_INFO, info,
                                                info_length);
    }
    if (status == PSA_SUCCESS) {
        status = psa_key_derivation_output_bytes(&operation, out, out_length);
    }
    (void)psa_key_derivation_abort(&operation);
    return status == PSA_SUCCESS;
}

bool device_keys_derive(const uint8_t *master, size_t master_length, device_key_purpose_t purpose,
                        const uint8_t device_id[DEVICE_ID_SIZE], uint8_t key[DEVICE_KEY_SIZE])
{
    uint8_t info[LONGEST_LABEL + DEVICE_ID_SIZE];

    if ((size_t)purpose >= (sizeof labels / sizeof labels[0])) {
        return false;
    }

    const size_t label_length = strlen(labels[purpose]);

    (void)memcpy(info, labels[purpose], label_length);
    (void)memcpy(&info[label_length], device_id, DEVICE_ID_SIZE);
    return device_keys_hkdf(master, master_length, NULL, 0u, info, label_length + DEVICE_ID_SIZE,
                            key, DEVICE_KEY_SIZE);
}
```

## src/device_keys.h
```c
#ifndef DEVICE_KEYS_H
#define DEVICE_KEYS_H

#include "device_key.h"

#include <stdbool.h>
#include <stddef.h>
#include <stdint.h>

/** HKDF-SHA256 (RFC 5869) of `ikm` with `salt` and `info`, filling `out`. False if it can't. */
bool device_keys_hkdf(const uint8_t *ikm, size_t ikm_length, const uint8_t *salt,
                      size_t salt_length, const uint8_t *info, size_t info_length, uint8_t *out,
                      size_t out_length);

/** The key for `purpose` of the oximeter with `device_id`: HKDF-SHA256 of `master`, with no salt
 * and the purpose's label followed by the ID as info. False if it can't. */
bool device_keys_derive(const uint8_t *master, size_t master_length, device_key_purpose_t purpose,
                        const uint8_t device_id[DEVICE_ID_SIZE], uint8_t key[DEVICE_KEY_SIZE]);

#endif
```

## src/limits_signer.c
```c
#include "limits_signer.h"

#include "medsec_crypto.h"

#include <psa/crypto.h>

static psa_key_id_t key_id = PSA_KEY_ID_NULL;

bool limits_signer_init(const uint8_t *key, size_t length)
{
    /* The hub only makes these tags, standing in for the backend that will. */
    return medsec_mac_key_load(&key_id, key, length, PSA_KEY_USAGE_SIGN_MESSAGE);
}

bool limits_signer_sign(const uint8_t challenge[LIMITS_AUTH_CHALLENGE_SIZE],
                        const alarm_limits_t *limits, uint8_t command[LIMITS_AUTH_COMMAND_SIZE])
{
    uint8_t message[LIMITS_AUTH_MESSAGE_SIZE];
    size_t tag_length;

    limits_auth_message(challenge, limits, message);
    alarm_limits_encode(limits, command);
    return psa_mac_compute(key_id, MEDSEC_MAC, message, sizeof message, &command[ALARM_LIMITS_SIZE],
                           LIMITS_AUTH_TAG_SIZE, &tag_length) == PSA_SUCCESS;
}
```

## src/limits_signer.h
```c
#ifndef LIMITS_SIGNER_H
#define LIMITS_SIGNER_H

#include "alarm.h"
#include "limits_auth.h"

#include <stdbool.h>
#include <stddef.h>
#include <stdint.h>

/** Loads the key the hub signs limit changes with, replacing any loaded before. Returns false, with
 * no key loaded, if it can't. */
bool limits_signer_init(const uint8_t *key, size_t length);

/** Makes the command that sets `limits`, signed over the oximeter's `challenge`. False if it can't.
 */
bool limits_signer_sign(const uint8_t challenge[LIMITS_AUTH_CHALLENGE_SIZE],
                        const alarm_limits_t *limits, uint8_t command[LIMITS_AUTH_COMMAND_SIZE]);

#endif
```

## src/log_verifier.c
```c
#include "log_verifier.h"

#include "medsec_crypto.h"

#include <psa/crypto.h>
#include <zephyr/sys/byteorder.h>

static psa_key_id_t key_id = PSA_KEY_ID_NULL;

bool log_verifier_init(const uint8_t *key, size_t length)
{
    /* The backend only checks the log's tags; only the oximeter makes them. */
    return medsec_mac_key_load(&key_id, key, length, PSA_KEY_USAGE_VERIFY_MESSAGE);
}

/* psa_mac_verify compares in constant time. */
bool log_verifier_check(const uint8_t entry[SECURITY_LOG_ENTRY_SIZE])
{
    return psa_mac_verify(key_id, MEDSEC_MAC, entry, SECURITY_LOG_RECORD_SIZE,
                          &entry[SECURITY_LOG_RECORD_SIZE], SECURITY_LOG_TAG_SIZE) == PSA_SUCCESS;
}

/* The tag covers the hub's own challenge, so an answer to an earlier one, replayed, fails; and the
 * number, so neither can a changed one. */
bool log_verifier_check_head(const uint8_t challenge[SECURITY_LOG_CHALLENGE_SIZE],
                             const uint8_t answer[SECURITY_LOG_HEAD_ANSWER_SIZE], uint32_t *newest)
{
    const uint32_t sequence = sys_get_le32(answer);
    uint8_t message[SECURITY_LOG_HEAD_MESSAGE_SIZE];

    security_log_head_message(challenge, sequence, message);
    if (psa_mac_verify(key_id, MEDSEC_MAC, message, sizeof message, &answer[sizeof sequence],
                       SECURITY_LOG_TAG_SIZE) != PSA_SUCCESS) {
        return false;
    }
    *newest = sequence;
    return true;
}
```

## src/log_verifier.h
```c
#ifndef LOG_VERIFIER_H
#define LOG_VERIFIER_H

#include "security_log.h"

#include <stdbool.h>
#include <stddef.h>
#include <stdint.h>

/** Loads the log key of the oximeter being read, replacing any loaded before. Returns false, with
 * no key loaded, if it can't. */
bool log_verifier_init(const uint8_t *key, size_t length);

/** True if `entry`'s tag is the MAC of its record under the loaded log key. */
bool log_verifier_check(const uint8_t entry[SECURITY_LOG_ENTRY_SIZE]);

/** True if `answer` is the oximeter's to `challenge`, tagged under the loaded log key; then
 * `newest` is its newest record's sequence number. */
bool log_verifier_check_head(const uint8_t challenge[SECURITY_LOG_CHALLENGE_SIZE],
                             const uint8_t answer[SECURITY_LOG_HEAD_ANSWER_SIZE], uint32_t *newest);

#endif
```

## src/pairing.c
```c
#include "pairing.h"

#include "pairing_seal.h"

#include <errno.h>
#include <mbedtls/platform_util.h>
#include <string.h>
#include <zephyr/bluetooth/gatt.h>
#include <zephyr/logging/log.h>
#include <zephyr/shell/shell.h>

LOG_MODULE_REGISTER(pairing, LOG_LEVEL_INF);

BUILD_ASSERT(sizeof(struct bt_le_oob_sc_data) == PAIRING_DATA_SIZE,
             "the oximeter seals exactly its LE Secure Connections out-of-band data");

/* Used on the Bluetooth receive thread only, from the read until pairing ends. The sealed data
 * may arrive in pieces. */
static uint8_t oximeter_id[DEVICE_ID_SIZE];
static uint8_t sealed[PAIRING_SEALED_SIZE];
static size_t sealed_length;
static struct bt_gatt_read_params sealed_read;
static struct bt_le_oob_sc_data oximeter_oob;

/* Set from the Bluetooth receive thread, read from the shell's: the oximeter that no longer knows
 * this hub's bond, until the hub pairs with it again. */
static bt_addr_le_t forgotten_by;
static bool forgotten;

static uint8_t on_sealed(struct bt_conn *conn, uint8_t err, struct bt_gatt_read_params *params,
                         const void *data, uint16_t length)
{
    ARG_UNUSED(params);
    if (err != 0u) {
        LOG_WRN("couldn't read the oximeter's pairing data (ATT error 0x%02x)", err);
        return BT_GATT_ITER_STOP;
    }
    if (data != NULL) {
        if (length > (sizeof sealed - sealed_length)) {
            LOG_WRN("the oximeter's pairing data is too long");
            return BT_GATT_ITER_STOP;
        }
        (void)memcpy(&sealed[sealed_length], data, length);
        sealed_length += length;
        return BT_GATT_ITER_CONTINUE;
    }
    if ((sealed_length != sizeof sealed) ||
        !pairing_open(oximeter_id, sealed, (uint8_t *)&oximeter_oob)) {
        LOG_WRN("couldn't open the oximeter's pairing data");
        return BT_GATT_ITER_STOP;
    }

    const int start_err = bt_conn_set_security(conn, BT_SECURITY_L4);

    if (start_err != 0) {
        LOG_ERR("pairing didn't start: %d", start_err);
    }
    return BT_GATT_ITER_STOP;
}

void pairing_start(struct bt_conn *conn, uint16_t sealed_handle,
                   const uint8_t device_id[DEVICE_ID_SIZE], const uint8_t key[DEVICE_KEY_SIZE])
{
    if (bt_le_bond_exists(BT_ID_DEFAULT, bt_conn_get_dst(conn))) {
        LOG_INF("using the oximeter's bond");

        const int err = bt_conn_set_security(conn, BT_SECURITY_L4);

        if (err != 0) {
            LOG_ERR("encrypting with the bond didn't start: %d", err);
        }
        return;
    }
    if (!pairing_open_init(key, DEVICE_KEY_SIZE)) {
        LOG_ERR("couldn't load the oximeter's pairing key");
        return;
    }
    (void)memcpy(oximeter_id, device_id, sizeof oximeter_id);
    sealed_length = 0u;
    sealed_read.func = on_sealed;
    sealed_read.handle_count = 1u;
    sealed_read.single.handle = sealed_handle;
    sealed_read.single.offset = 0u;

    const int err = bt_gatt_read(conn, &sealed_read);

    if (err != 0) {
        LOG_ERR("reading the oximeter's pairing data failed: %d", err);
    }
}

/* The oximeter's data only: it has none of the hub's, and doesn't need it. Checking its data
 * proves the oximeter is the one that sealed it; pairing with it proves to the oximeter that the
 * hub could open it. */
static void on_oob_data_request(struct bt_conn *conn, struct bt_conn_oob_info *info)
{
    ARG_UNUSED(info);

    const int err = bt_le_oob_set_sc_data(conn, NULL, &oximeter_oob);

    if (err != 0) {
        LOG_ERR("couldn't give pairing the oximeter's data: %d", err);
        (void)bt_conn_auth_cancel(conn);
    }
}

/* The out-of-band data is a secret only until pairing ends. */
static void on_pairing_complete(struct bt_conn *conn, bool bonded)
{
    ARG_UNUSED(conn);
    ARG_UNUSED(bonded);
    mbedtls_platform_zeroize(&oximeter_oob, sizeof oximeter_oob);
    LOG_INF("paired with the oximeter");
}

static void on_pairing_failed(struct bt_conn *conn, enum bt_security_err reason)
{
    ARG_UNUSED(conn);
    mbedtls_platform_zeroize(&oximeter_oob, sizeof oximeter_oob);
    LOG_WRN("pairing failed (reason %d)", reason);
}

static struct bt_conn_auth_cb auth_callbacks = {
    .oob_data_request = on_oob_data_request,
};

static struct bt_conn_auth_info_cb auth_info_callbacks = {
    .pairing_complete = on_pairing_complete,
    .pairing_failed = on_pairing_failed,
};

/* An oximeter reset for a new patient has no key for the bond: encryption with it fails, key
 * missing. The hub pairs again only when the backend allows it, as it does for the next patient's
 * gateway alone. */
static void on_security_changed(struct bt_conn *conn, bt_security_t level, enum bt_security_err err)
{
    ARG_UNUSED(level);
    if (err == BT_SECURITY_ERR_PIN_OR_KEY_MISSING) {
        bt_addr_le_copy(&forgotten_by, bt_conn_get_dst(conn));
        forgotten = true;
        LOG_WRN("the oximeter has forgotten this hub");
    }
}

BT_CONN_CB_DEFINE(pairing_connection_callbacks) = {
    .security_changed = on_security_changed,
};

/* The backend's go-ahead, which the hub stands in for. Dropping the bond also ends the link, and
 * the next connection pairs with the oximeter's sealed data. */
static int cmd_pair(const struct shell *sh, size_t argc, char **argv)
{
    ARG_UNUSED(argc);
    ARG_UNUSED(argv);
    if (!forgotten) {
        shell_error(sh, "no oximeter has forgotten this hub");
        return -ENOENT;
    }
    forgotten = false;

    const int err = bt_unpair(BT_ID_DEFAULT, &forgotten_by);

    if (err != 0) {
        shell_error(sh, "couldn't drop the oximeter's bond: %d", err);
        return err;
    }
    LOG_INF("pairing with the oximeter again");
    return 0;
}

SHELL_CMD_REGISTER(pair, NULL, "Pair again with the oximeter that has forgotten this hub",
                   cmd_pair);

int pairing_init(void)
{
    /* Every pairing the hub starts uses the oximeter's out-of-band data. */
    bt_le_oob_set_sc_flag(true);

    const int err = bt_conn_auth_cb_register(&auth_callbacks);

    return (err != 0) ? err : bt_conn_auth_info_cb_register(&auth_info_callbacks);
}
```

## src/pairing.h
```c
#ifndef PAIRING_H
#define PAIRING_H

#include "device_key.h"

#include <stdint.h>
#include <zephyr/bluetooth/conn.h>

/** Registers the hub's side of pairing. Returns 0 or -errno. */
int pairing_init(void);

/** Secures the link to the oximeter on `conn` at security level 4: with the bond, if the hub has
 * one; otherwise by pairing, reading its sealed out-of-band data at `sealed_handle` and opening it
 * with `key`, the pairing key derived for the oximeter with `device_id`. The connection's
 * security_changed callback has the result. */
void pairing_start(struct bt_conn *conn, uint16_t sealed_handle,
                   const uint8_t device_id[DEVICE_ID_SIZE], const uint8_t key[DEVICE_KEY_SIZE]);

#endif
```

## src/update.c
```c
#include "update.h"

#include <errno.h>
#include <string.h>
#include <zephyr/bluetooth/gatt.h>
#include <zephyr/logging/log.h>
#include <zephyr/mgmt/mcumgr/grp/img_mgmt/img_mgmt_client.h>
#include <zephyr/mgmt/mcumgr/grp/os_mgmt/os_mgmt_client.h>
#include <zephyr/mgmt/mcumgr/smp/smp.h>
#include <zephyr/mgmt/mcumgr/smp/smp_client.h>
#include <zephyr/mgmt/mcumgr/transport/smp.h>
#include <zephyr/shell/shell.h>
#include <zephyr/shell/shell_string_conv.h>
#include <zephyr/storage/flash_map.h>
/* Zephyr's own SMP transports collect what they receive with its reassembly helper, which only this
 * internal header declares: there's no public way in for a transport of one's own. */
#include <mgmt/mcumgr/transport/smp_reassembly.h>

LOG_MODULE_REGISTER(update, LOG_LEVEL_INF);

/* The backend's image, kept where the gateway would keep it: the hub's slot 1 partition, which the
 * hub's own firmware, at the start of flash, doesn't use. Flash is memory-mapped. */
#define STAGED ((const uint8_t *)PARTITION_ADDRESS(slot1_partition))
#define STAGED_MAX PARTITION_SIZE(slot1_partition)

/* MCUboot's slot for an update. */
#define SECONDARY_SLOT 1u

/* Set from the Bluetooth receive thread, read from the shell's while an update runs; one oximeter
 * at a time. */
static struct bt_conn *oximeter;
static uint16_t smp_handle;
static bool subscribed;

static struct smp_transport transport;
static struct smp_client_transport_entry transport_entry;
static struct smp_client_object smp_client;
static struct img_mgmt_client image_client;
static struct os_mgmt_client os_client;
static struct mcumgr_image_data images[2];
static struct bt_gatt_subscribe_params responses;
static struct bt_gatt_discover_params responses_ccc;

/* An ATT write carries the MTU less its 3-byte header. */
static uint16_t request_size(const struct net_buf *nb)
{
    ARG_UNUSED(nb);
    return (oximeter == NULL) ? 0u : (uint16_t)(bt_gatt_get_mtu(oximeter) - 3u);
}

/* A request in ATT writes of up to the size above; the oximeter puts them back together. */
static int send_request(struct net_buf *nb)
{
    int err = (oximeter == NULL) ? -ENOTCONN : 0;

    for (uint16_t sent = 0u; (err == 0) && (sent < nb->len);) {
        const uint16_t piece = MIN(nb->len - sent, request_size(nb));

        err = bt_gatt_write_without_response(oximeter, smp_handle, &nb->data[sent], piece, false);
        sent += piece;
    }
    smp_packet_free(nb);
    return err;
}

/* A response longer than one notification, such as the image list, comes in pieces: the SMP
 * header says how long it is, and it goes to the client once it's all here. */
static uint8_t on_response(struct bt_conn *conn, struct bt_gatt_subscribe_params *params,
                           const void *data, uint16_t length)
{
    ARG_UNUSED(conn);
    if (data == NULL) {
        params->value_handle = 0u;
        subscribed = false;
        return BT_GATT_ITER_STOP;
    }

    const int remaining = smp_reassembly_collect(&transport, data, length);

    if (remaining < 0) {
        LOG_WRN("SMP response dropped (%d)", remaining);
        smp_reassembly_drop(&transport);
    } else if (remaining == 0) {
        (void)smp_reassembly_complete(&transport, false);
    }
    return BT_GATT_ITER_CONTINUE;
}

void update_found(struct bt_conn *conn, uint16_t handle)
{
    oximeter = conn;
    smp_handle = handle;
}

/* The oximeter answers in notifications: commands wait until their CCC write is through. */
static void on_subscribed(struct bt_conn *conn, uint8_t err,
                          struct bt_gatt_subscribe_params *params)
{
    ARG_UNUSED(conn);
    ARG_UNUSED(params);
    if (err != BT_ATT_ERR_SUCCESS) {
        LOG_WRN("subscribing to SMP failed (ATT error 0x%02x)", err);
        return;
    }
    subscribed = true;
    LOG_INF("ready to update the oximeter");
}

void update_link_secured(struct bt_conn *conn)
{
    if (smp_handle == 0u) {
        return;
    }
    responses.value_handle = smp_handle;
    responses.ccc_handle = BT_GATT_AUTO_DISCOVER_CCC_HANDLE;
    responses.end_handle = BT_ATT_LAST_ATTRIBUTE_HANDLE;
    responses.disc_params = &responses_ccc;
    responses.value = BT_GATT_CCC_NOTIFY;
    responses.notify = on_response;
    responses.subscribe = on_subscribed;
    /* Made again on each link, as main.c's are. */
    atomic_set_bit(responses.flags, BT_GATT_SUBSCRIBE_FLAG_VOLATILE);

    const int err = bt_gatt_subscribe(conn, &responses);

    if ((err != 0) && (err != -EALREADY)) {
        LOG_ERR("subscribing to SMP failed: %d", err);
    }
}

static void on_disconnected(struct bt_conn *conn, uint8_t reason)
{
    ARG_UNUSED(conn);
    ARG_UNUSED(reason);
    oximeter = NULL;
}

BT_CONN_CB_DEFINE(update_connection_callbacks) = {
    .disconnected = on_disconnected,
};

static bool ready(const struct shell *sh)
{
    if ((oximeter == NULL) || !subscribed) {
        shell_error(sh, "the oximeter isn't ready for updates");
        return false;
    }
    return true;
}

static const char *uploaded_hash(void)
{
    struct mcumgr_image_state state;

    if ((img_mgmt_client_state_read(&image_client, &state) != MGMT_ERR_EOK) ||
        (state.status != MGMT_ERR_EOK)) {
        return NULL;
    }
    for (int i = 0; i < state.image_list_length; i++) {
        if (state.image_list[i].slot_num == SECONDARY_SLOT) {
            return state.image_list[i].hash;
        }
    }
    return NULL;
}

/* Sends the staged image, marks it for a test boot, and resets the oximeter into it: it runs once,
 * and stays only if it passes its self-test. */
static int cmd_update(const struct shell *sh, size_t argc, char **argv)
{
    int err = 0;
    const unsigned long size = shell_strtoul(argv[1], 0, &err);

    ARG_UNUSED(argc);
    if ((err != 0) || (size == 0u) || (size > STAGED_MAX)) {
        shell_error(sh, "%s isn't the size of a staged image", argv[1]);
        return -EINVAL;
    }
    if (!ready(sh)) {
        return -ENOTCONN;
    }
    /* The shortest connection interval while the image goes: about 20 s rather than 2 min. The
     * supervision timeout stays at 420 ms. */
    (void)bt_conn_le_param_update(oximeter, BT_LE_CONN_PARAM(6, 6, 0, 42));

    struct mcumgr_image_upload upload = {0};

    if ((img_mgmt_client_upload_init(&image_client, size, 0u, NULL) != MGMT_ERR_EOK) ||
        (img_mgmt_client_upload(&image_client, STAGED, size, &upload) != MGMT_ERR_EOK) ||
        (upload.status != MGMT_ERR_EOK)) {
        shell_error(sh, "sending the update failed (%d)", upload.status);
        return -EIO;
    }

    const char *hash = uploaded_hash();
    struct mcumgr_image_state state = {0};

    if ((hash == NULL) ||
        (img_mgmt_client_state_write(&image_client, (char *)hash, false, &state) != MGMT_ERR_EOK) ||
        (state.status != MGMT_ERR_EOK)) {
        shell_error(sh, "marking the update for a test boot failed (%d)", state.status);
        return -EIO;
    }
    if (os_mgmt_client_reset(&os_client) != MGMT_ERR_EOK) {
        shell_error(sh, "resetting the oximeter failed");
        return -EIO;
    }
    LOG_INF("the oximeter is restarting with the update");
    return 0;
}

/* Standard MCUmgr tools confirm an update from outside once it's running, and the hub can do the
 * same. This oximeter refuses: it keeps an update only once its own self-test passes. */
static int cmd_confirm(const struct shell *sh, size_t argc, char **argv)
{
    ARG_UNUSED(argc);
    ARG_UNUSED(argv);
    if (!ready(sh)) {
        return -ENOTCONN;
    }

    struct mcumgr_image_state state = {0};
    const int err = img_mgmt_client_state_write(&image_client, NULL, true, &state);

    if ((err != MGMT_ERR_EOK) || (state.status != MGMT_ERR_EOK)) {
        LOG_WRN("the oximeter refused to keep the update (%d, %d)", err, state.status);
        return -EACCES;
    }
    LOG_INF("the oximeter keeps the image it runs for good");
    return 0;
}

SHELL_CMD_REGISTER(confirm, NULL, "Ask the oximeter to keep the image it runs for good",
                   cmd_confirm);

SHELL_CMD_ARG_REGISTER(update, NULL,
                       "Send the oximeter the update staged in slot 1: update <size in bytes>",
                       cmd_update, 2, 0);

int update_init(void)
{
    transport.functions.output = send_request;
    transport.functions.get_mtu = request_size;

    int err = smp_transport_init(&transport);

    if (err != 0) {
        return err;
    }
    transport_entry.smpt = &transport;
    transport_entry.smpt_type = SMP_BLUETOOTH_TRANSPORT;
    smp_client_transport_register(&transport_entry);
    err = smp_client_object_init(&smp_client, SMP_BLUETOOTH_TRANSPORT);
    if (err != 0) {
        return err;
    }
    img_mgmt_client_init(&image_client, &smp_client, ARRAY_SIZE(images), images);
    os_mgmt_client_init(&os_client, &smp_client);
    return 0;
}
```

## src/update.h
```c
#ifndef UPDATE_H
#define UPDATE_H

#include <stdint.h>
#include <zephyr/bluetooth/conn.h>

/** Sets up the SMP client that sends the oximeter its updates. Returns 0 or -errno. */
int update_init(void);

/** Notes the oximeter's SMP characteristic at `handle`, found by discovery on `conn`. */
void update_found(struct bt_conn *conn, uint16_t handle);

/** Subscribes to the oximeter's SMP responses, which only a link at level 4 may. */
void update_link_secured(struct bt_conn *conn);

#endif
```
