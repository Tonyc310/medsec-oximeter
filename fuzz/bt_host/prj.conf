## CMakeLists.txt
```
cmake_minimum_required(VERSION 3.20.0)

set(APP ${CMAKE_CURRENT_SOURCE_DIR}/../../app)
set(CORE ${APP}/../core)
set(COMMON ${APP}/../common)
# The oximeter's flash and crypto settings, as its own build applies them.
list(APPEND EXTRA_CONF_FILE ${COMMON}/limits_crypto.conf ${COMMON}/pairing_crypto.conf
    ${APP}/limits_store.conf)
find_package(Zephyr REQUIRED HINTS $ENV{ZEPHYR_BASE})
project(bt_host_fuzz LANGUAGES C)

# The oximeter's Bluetooth services and admission, built from its own sources.
target_sources(app PRIVATE src/main.c src/hci_fuzz.c src/fixed_identity.c src/paired_only.c
    ${APP}/src/admission.c ${APP}/src/alarm_service.c ${APP}/src/event_log.c
    ${APP}/src/limits_crypto.c ${APP}/src/limits_store.c ${APP}/src/log_mac.c ${APP}/src/pairing.c
    ${APP}/src/plx_service.c
    ${CORE}/src/alarm.c ${CORE}/src/device_key.c ${CORE}/src/limits_auth.c
    ${CORE}/src/link_admission.c ${CORE}/src/plx.c ${CORE}/src/security_log.c
    ${COMMON}/src/medsec_crypto.c ${COMMON}/src/pairing_seal.c)
target_include_directories(app PRIVATE ${APP}/src ${CORE}/include ${COMMON}/include)
```

## Kconfig
```
# Each case reaches Zephyr as an interrupt, as in Zephyr's fuzzing sample.
config ARCH_POSIX_FUZZ_IRQ
	int "Interrupt that delivers each fuzz case"
	default 31

config ARCH_POSIX_FUZZ_TICKS
	int "Ticks of simulated time each fuzz case gets"
	default 2

source "Kconfig.zephyr"
```

## prj.conf
```kconfig
# libFuzzer, with AddressSanitizer and UndefinedBehaviorSanitizer: clang only.
CONFIG_ARCH_POSIX_LIBFUZZER=y
CONFIG_ASAN=y
CONFIG_UBSAN=y
# Below the Bluetooth host's threads, which then handle each packet as soon as it arrives.
CONFIG_MAIN_THREAD_PRIORITY=14
CONFIG_LOG=n

# The Bluetooth host as the oximeter configures it (app/prj.conf), over a controller the fuzzer
# plays (src/hci_fuzz.c).
CONFIG_BT=y
CONFIG_BT_PERIPHERAL=y
CONFIG_BT_DEVICE_NAME="medsec-oximeter"
CONFIG_BT_PRIVACY=y
CONFIG_BT_SMP=y
CONFIG_BT_SMP_SC_ONLY=y
CONFIG_BT_SETTINGS=y
CONFIG_BT_GATT_AUTO_SEC_REQ=n
CONFIG_BT_MAX_PAIRED=1
CONFIG_BT_KEYS_OVERWRITE_OLDEST=y
CONFIG_BT_MAX_CONN=2
CONFIG_BT_FILTER_ACCEPT_LIST=y
CONFIG_BT_GAP_AUTO_UPDATE_CONN_PARAMS=n
CONFIG_BT_GATT_CACHING=n
CONFIG_BT_GATT_READ_MULTIPLE=n
CONFIG_BT_GATT_READ_MULT_VAR_LEN=n
CONFIG_BT_BUF_ACL_RX_SIZE=251
CONFIG_BT_L2CAP_TX_MTU=247
CONFIG_BT_BUF_ACL_TX_SIZE=251

# What the oximeter's services use: the alarm LED, and the reset cause for the security log.
CONFIG_GPIO=y
CONFIG_HWINFO=y
# src/paired_only.c, which sees every attribute a request reaches.
CONFIG_BT_GATT_AUTHORIZATION_CUSTOM=y
```

## app.overlay
```dts
/ {
	chosen {
		zephyr,bt-hci = &fuzz_hci;
	};

	fuzz_hci: fuzz_hci {
		compatible = "vnd,bt-hci-fuzz";
	};
};

&bt_hci_userchan {
	status = "disabled";
};
```

## dts/bindings/vnd,bt-hci-fuzz.yaml
```yaml
description: A Bluetooth controller the fuzzer plays, in place of the radio

compatible: "vnd,bt-hci-fuzz"

include: bt-hci.yaml

properties:
  bt-hci-name:
    default: "fuzz"
  bt-hci-bus:
    default: "virtual"
```

## src/main.c
```c
/* Any bytes, as a central that never pairs could send them to the oximeter: each case connects,
 * delivers L2CAP frames on any channel, and leaves. The oximeter's own Bluetooth services and
 * admission answer, started as the firmware starts them. */
#include "alarm_service.h"
#include "device_identity.h"
#include "event_log.h"
#include "hci_fuzz.h"
#include "log_mac.h"
#include "paired_only.h"
#include "pairing.h"
#include "pairing_seal.h"
#include "plx_service.h"

#include <irq_ctrl.h>
#include <nsi_cpu_if.h>
#include <nsi_main_semipublic.h>
#include <zephyr/irq.h>
#include <zephyr/kernel.h>
#include <zephyr/sys/byteorder.h>

#include <stdbool.h>
#include <stdint.h>
#include <stdlib.h>
#include <string.h>

#define CONNECTION 0x0001u
/* An L2CAP frame's header: its payload's length, then its channel. */
#define L2CAP_HEADER 4u
#define PAYLOAD_MAX (251u - L2CAP_HEADER)
/* Channels with no L2CAP header added: the start of a frame as it is, header and all, or the rest
 * of one. */
#define RAW_START 0xFEu
#define RAW_REST 0xFFu

static const uint8_t *fuzz_case;
static size_t fuzz_case_size;
/* Set once the host has taken a whole case. A host that stops taking packets would otherwise leave
 * every later case unread, and the fuzzer testing nothing. */
static volatile bool fuzz_case_done;
static K_SEM_DEFINE(fuzz_case_ready, 0, 1);

static void on_fuzz_case(const void *arg)
{
    ARG_UNUSED(arg);
    k_sem_give(&fuzz_case_ready);
}

/* An L2CAP frame on `channel`, its header made to fit, so a mutated payload still arrives whole. */
static void send_frame(uint8_t channel, const uint8_t *payload, size_t length)
{
    uint8_t frame[L2CAP_HEADER + PAYLOAD_MAX];
    const size_t taken = MIN(length, (size_t)PAYLOAD_MAX);

    sys_put_le16((uint16_t)taken, &frame[0]);
    sys_put_le16(channel, &frame[2]);
    (void)memcpy(&frame[L2CAP_HEADER], payload, taken);
    hci_fuzz_acl(CONNECTION, true, frame, L2CAP_HEADER + taken);
}

/* Each packet is a channel byte, a length byte, then that many bytes; the last may be cut short. */
static void deliver(const uint8_t *data, size_t size)
{
    size_t at = 0u;

    hci_fuzz_connect(CONNECTION);
    while (at + 2u <= size) {
        const uint8_t channel = data[at];
        const uint8_t *bytes = &data[at + 2u];
        const size_t length = MIN((size_t)data[at + 1u], size - at - 2u);

        if ((channel == RAW_START) || (channel == RAW_REST)) {
            hci_fuzz_acl(CONNECTION, channel == RAW_START, bytes, length);
        } else {
            send_frame(channel, bytes, length);
        }
        at += 2u + length;
    }
    hci_fuzz_disconnect(CONNECTION);
}

/* As app/src/main.c starts them, without the sensor, the watchdog or MCUboot. */
static bool start_the_oximeter(void)
{
    static const struct mcuboot_img_sem_ver version = {.major = 1u};
    uint8_t key[DEVICE_KEY_SIZE];

    return device_identity_key(DEVICE_KEY_LOG, key) && log_mac_init(key, sizeof key) &&
           device_identity_key(DEVICE_KEY_PAIRING, key) && pairing_seal_init(key, sizeof key) &&
           (event_log_start(&version) == 0) && (alarm_service_init() == 0) &&
           (pairing_init() == 0) && (plx_service_start() == 0);
}

int main(void)
{
    paired_only_watch();
    if (!start_the_oximeter()) {
        printk("the oximeter's services didn't start\n");
        abort();
    }
    IRQ_CONNECT(CONFIG_ARCH_POSIX_FUZZ_IRQ, 0, on_fuzz_case, NULL, 0);
    irq_enable(CONFIG_ARCH_POSIX_FUZZ_IRQ);
    while (true) {
        (void)k_sem_take(&fuzz_case_ready, K_FOREVER);
        deliver(fuzz_case, fuzz_case_size);
        fuzz_case_done = true;
    }
    return 0;
}

/* libFuzzer's entry, on native_sim's host side: each case reaches Zephyr as an interrupt, and the
 * simulation runs until it has been handled. */
NATIVE_SIMULATOR_IF int LLVMFuzzerTestOneInput(const uint8_t *data, size_t size)
{
    static bool booted;

    if (!booted) {
        /* The settings and the security log in simulated flash kept in RAM, not in a file. */
        static char *argv[] = {"bt_host_fuzz", "-flash_in_ram", NULL};

        nsi_init(2, argv);
        booted = true;
    }
    fuzz_case = data;
    fuzz_case_size = size;
    fuzz_case_done = false;
    hw_irq_ctrl_set_irq(CONFIG_ARCH_POSIX_FUZZ_IRQ);
    nsi_exec_for(k_ticks_to_us_ceil64(CONFIG_ARCH_POSIX_FUZZ_TICKS));
    if (!fuzz_case_done) {
        printk("the host stopped taking packets\n");
        abort();
    }
    return 0;
}
```

## src/fixed_identity.c
```c
#include "device_identity.h"

#include <string.h>

/* native_sim has no UICR or FICR: the oximeter the Renode tests provision, with a key per purpose
 * that is neither erased nor zeroed, so every service starts as it does on a provisioned device. */
static const uint8_t device_id[DEVICE_ID_SIZE] = {0x01, 0x23, 0x45, 0x67, 0x89, 0xab, 0xcd, 0xef};

bool device_identity_key(device_key_purpose_t purpose, uint8_t key[DEVICE_KEY_SIZE])
{
    (void)memset(key, 0xA0 + (int)purpose, DEVICE_KEY_SIZE);
    return true;
}

int device_identity_id(uint8_t id[DEVICE_ID_SIZE])
{
    (void)memcpy(id, device_id, sizeof device_id);
    return 0;
}
```

## src/hci_fuzz.c
```c
#define DT_DRV_COMPAT vnd_bt_hci_fuzz

#include "hci_fuzz.h"

#include <zephyr/bluetooth/buf.h>
#include <zephyr/bluetooth/hci_types.h>
#include <zephyr/device.h>
#include <zephyr/drivers/bluetooth.h>
#include <zephyr/kernel.h>
#include <zephyr/sys/byteorder.h>

#include <string.h>

/* Room for any command's return parameters; those of a command not answered below are zeros. */
#define RETURN_MAX 64u
#define ACL_SIZE 251u
#define ACL_COUNT 4u
#define CONTROLLER_STACK_SIZE 2048

static bt_hci_recv_t host_recv;
static const struct device *controller;

static void to_host(struct net_buf *buf)
{
    (void)host_recv(controller, buf);
}

static void complete(uint16_t opcode, const void *parameters, uint8_t length)
{
    struct net_buf *buf = bt_hci_cmd_complete_create(opcode, length);

    net_buf_add_mem(buf, parameters, length);
    to_host(buf);
}

static void event(uint8_t code, const void *parameters, uint8_t length)
{
    struct net_buf *buf = bt_hci_evt_create(code, length);

    net_buf_add_mem(buf, parameters, length);
    to_host(buf);
}

static void le_event(uint8_t subevent, const void *parameters, uint8_t length)
{
    struct net_buf *buf = bt_hci_evt_create(BT_HCI_EVT_LE_META_EVENT, 1u + length);

    net_buf_add_u8(buf, subevent);
    net_buf_add_mem(buf, parameters, length);
    to_host(buf);
}

/* What the controller says about itself: Bluetooth 5.4, LE only, with encryption, data length
 * extension and the 2M PHY, as the nRF52840's has. */
static void answer(uint16_t opcode)
{
    uint8_t zeros[RETURN_MAX] = {0};

    switch (opcode) {
    case BT_HCI_OP_READ_LOCAL_VERSION_INFO: {
        const struct bt_hci_rp_read_local_version_info version = {
            .hci_version = BT_HCI_VERSION_5_4,
            .hci_revision = 0u,
            .lmp_version = BT_HCI_VERSION_5_4,
            .manufacturer = sys_cpu_to_le16(0xFFFFu),
        };

        complete(opcode, &version, sizeof version);
        break;
    }
    case BT_HCI_OP_READ_SUPPORTED_COMMANDS: {
        struct bt_hci_rp_read_supported_commands commands;

        (void)memset(&commands, 0xFF, sizeof commands);
        commands.status = BT_HCI_ERR_SUCCESS;
        /* No P-256 commands, so the host does that itself, as the oximeter's does. */
        commands.commands[34] &= (uint8_t)~(BIT(1) | BIT(2));
        complete(opcode, &commands, sizeof commands);
        break;
    }
    case BT_HCI_OP_READ_LOCAL_FEATURES: {
        struct bt_hci_rp_read_local_features features = {0};

        /* LE, and no BR/EDR. */
        features.features[4] = BIT(5) | BIT(6);
        complete(opcode, &features, sizeof features);
        break;
    }
    case BT_HCI_OP_READ_BD_ADDR: {
        const struct bt_hci_rp_read_bd_addr address = {
            .bdaddr = {{0x11, 0x22, 0x33, 0x44, 0x55, 0x66}}};

        complete(opcode, &address, sizeof address);
        break;
    }
    case BT_HCI_OP_LE_READ_LOCAL_FEATURES: {
        struct bt_hci_rp_le_read_local_features features = {0};

        features.features[0] = BIT(BT_LE_FEAT_BIT_ENC) | BIT(BT_LE_FEAT_BIT_DLE);
        features.features[1] = BIT(BT_LE_FEAT_BIT_PHY_2M - 8);
        complete(opcode, &features, sizeof features);
        break;
    }
    case BT_HCI_OP_LE_READ_BUFFER_SIZE: {
        const struct bt_hci_rp_le_read_buffer_size size = {
            .le_max_len = sys_cpu_to_le16(ACL_SIZE),
            .le_max_num = ACL_COUNT,
        };

        complete(opcode, &size, sizeof size);
        break;
    }
    case BT_HCI_OP_LE_READ_MAX_DATA_LEN: {
        const struct bt_hci_rp_le_read_max_data_len length = {
            .max_tx_octets = sys_cpu_to_le16(ACL_SIZE),
            .max_tx_time = sys_cpu_to_le16(2120u),
            .max_rx_octets = sys_cpu_to_le16(ACL_SIZE),
            .max_rx_time = sys_cpu_to_le16(2120u),
        };

        complete(opcode, &length, sizeof length);
        break;
    }
    case BT_HCI_OP_LE_READ_FAL_SIZE: {
        const struct bt_hci_rp_le_read_fal_size size = {.fal_size = 8u};

        complete(opcode, &size, sizeof size);
        break;
    }
    default:
        complete(opcode, zeros, sizeof zeros);
        break;
    }
}

/* The host waits for each packet it sends to be reported sent before it sends more. */
static atomic_t sent;
static uint16_t sent_handle;

static void report_sent(struct k_work *work)
{
    ARG_UNUSED(work);
    const atomic_val_t count = atomic_clear(&sent);
    struct {
        uint8_t handles;
        uint16_t handle;
        uint16_t count;
    } __packed completed = {.handles = 1u,
                            .handle = sys_cpu_to_le16(sent_handle),
                            .count = sys_cpu_to_le16((uint16_t)count)};

    if (count > 0) {
        event(BT_HCI_EVT_NUM_COMPLETED_PACKETS, &completed, sizeof completed);
    }
}

static K_WORK_DEFINE(sent_work, report_sent);

/* The reports come from a thread of the controller's own, above every host thread, as the
 * nRF52840's controller sends its events: the host and the oximeter wait on the system work queue
 * for commands to complete, and the host can't send them while packets wait to be reported. */
static K_THREAD_STACK_DEFINE(controller_stack, CONTROLLER_STACK_SIZE);
static struct k_work_q controller_queue;

static int fuzz_open(const struct device *dev, bt_hci_recv_t recv)
{
    controller = dev;
    host_recv = recv;
    k_work_queue_start(&controller_queue, controller_stack, K_THREAD_STACK_SIZEOF(controller_stack),
                       K_PRIO_COOP(CONFIG_BT_DRIVER_RX_HIGH_PRIO), NULL);
    return 0;
}

static int fuzz_send(const struct device *dev, struct net_buf *buf)
{
    ARG_UNUSED(dev);
    const uint8_t type = net_buf_pull_u8(buf);

    if (type == BT_HCI_H4_CMD) {
        const struct bt_hci_cmd_hdr *header = (const void *)buf->data;

        answer(sys_le16_to_cpu(header->opcode));
    } else if (type == BT_HCI_H4_ACL) {
        const struct bt_hci_acl_hdr *header = (const void *)buf->data;

        sent_handle = bt_acl_handle(sys_le16_to_cpu(header->handle));
        (void)atomic_inc(&sent);
        (void)k_work_submit_to_queue(&controller_queue, &sent_work);
    }
    net_buf_unref(buf);
    return 0;
}

void hci_fuzz_connect(uint16_t handle)
{
    const struct bt_hci_evt_le_enh_conn_complete connected = {
        .handle = sys_cpu_to_le16(handle),
        .role = BT_HCI_ROLE_PERIPHERAL,
        .peer_addr = {.type = BT_ADDR_LE_RANDOM, .a = {{0x01, 0x02, 0x03, 0x04, 0x05, 0xC6}}},
        .interval = sys_cpu_to_le16(24u),
        .supv_timeout = sys_cpu_to_le16(42u),
    };

    le_event(BT_HCI_EVT_LE_ENH_CONN_COMPLETE, &connected, sizeof connected);
}

void hci_fuzz_disconnect(uint16_t handle)
{
    const struct bt_hci_evt_disconn_complete disconnected = {
        .handle = sys_cpu_to_le16(handle),
        .reason = BT_HCI_ERR_REMOTE_USER_TERM_CONN,
    };

    event(BT_HCI_EVT_DISCONN_COMPLETE, &disconnected, sizeof disconnected);
}

void hci_fuzz_acl(uint16_t handle, bool start, const uint8_t *data, size_t length)
{
    struct net_buf *buf = bt_buf_get_rx(BT_BUF_ACL_IN, K_FOREVER);
    struct bt_hci_acl_hdr *header = net_buf_add(buf, sizeof *header);
    const size_t taken = MIN(length, (size_t)ACL_SIZE);

    header->handle =
        sys_cpu_to_le16(bt_acl_handle_pack(handle, start ? BT_ACL_START : BT_ACL_CONT));
    header->len = sys_cpu_to_le16((uint16_t)taken);
    net_buf_add_mem(buf, data, taken);
    to_host(buf);
}

static DEVICE_API(bt_hci, fuzz_api) = {
    .open = fuzz_open,
    .send = fuzz_send,
};

DEVICE_DT_INST_DEFINE(0, NULL, NULL, NULL, NULL, POST_KERNEL, CONFIG_KERNEL_INIT_PRIORITY_DEVICE,
                      &fuzz_api);
```

## src/hci_fuzz.h
```c
#ifndef HCI_FUZZ_H
#define HCI_FUZZ_H

#include <stdbool.h>
#include <stddef.h>
#include <stdint.h>

/* The controller the fuzzer plays: it answers the host's commands, and gives the host what the
 * harness says a central sent, as a controller gives it what the radio heard. */

/** A central connects, the host advertising. */
void hci_fuzz_connect(uint16_t handle);

/** The central leaves. */
void hci_fuzz_disconnect(uint16_t handle);

/** An ACL packet from the central: the start of an L2CAP frame, or the rest of one. */
void hci_fuzz_acl(uint16_t handle, bool start, const uint8_t *data, size_t length);

#endif
```

## src/paired_only.c
```c
#include "paired_only.h"

#include "medsec_bt.h"

#include <stdlib.h>
#include <zephyr/bluetooth/conn.h>
#include <zephyr/bluetooth/gatt.h>
#include <zephyr/bluetooth/uuid.h>
#include <zephyr/sys/iterable_sections.h>
#include <zephyr/sys/printk.h>

static const struct bt_uuid_128 device_id_uuid = BT_UUID_INIT_128(MEDSEC_DEVICE_ID_VAL);
static const struct bt_uuid_128 sealed_uuid = BT_UUID_INIT_128(MEDSEC_SEALED_PAIRING_DATA_VAL);

/* What a central reads to find the oximeter's services and pair. A descriptor's subscription state
 * is the reader's own, so reading it gives nothing away. */
static const struct bt_uuid *const open_to_read[] = {
    BT_UUID_GATT_PRIMARY, BT_UUID_GATT_CHRC, BT_UUID_GATT_CCC,
    &device_id_uuid.uuid, &sealed_uuid.uuid,
};

/* Zephyr's GAP and GATT services hold nothing of the oximeter's. Static services take consecutive
 * handles, the service declaration first; a handle in none of them is the oximeter's. */
static bool in_zephyr_service(const struct bt_gatt_attr *attr)
{
    const uint16_t handle = bt_gatt_attr_get_handle(attr);

    STRUCT_SECTION_FOREACH(bt_gatt_service_static, service) {
        const uint16_t first = bt_gatt_attr_get_handle(&service->attrs[0]);

        if ((handle >= first) && ((size_t)(handle - first) < service->attr_count)) {
            const struct bt_uuid *uuid = service->attrs[0].user_data;

            return (bt_uuid_cmp(uuid, BT_UUID_GAP) == 0) || (bt_uuid_cmp(uuid, BT_UUID_GATT) == 0);
        }
    }
    return false;
}

static bool open_before_pairing(const struct bt_gatt_attr *attr)
{
    for (size_t i = 0u; i < ARRAY_SIZE(open_to_read); i++) {
        if (bt_uuid_cmp(attr->uuid, open_to_read[i]) == 0) {
            return true;
        }
    }
    return false;
}

static void reached(const char *access, const struct bt_gatt_attr *attr)
{
    printk("C-04: a central below level 4 %s handle 0x%04x\n", access,
           bt_gatt_attr_get_handle(attr));
    abort();
}

/* Zephyr asks once an attribute's permissions allow the request, on every ATT path that reads or
 * writes a value, so these see whatever a permission lets through. */
static bool on_read(struct bt_conn *conn, const struct bt_gatt_attr *attr)
{
    if ((bt_conn_get_security(conn) < BT_SECURITY_L4) && !in_zephyr_service(attr) &&
        !open_before_pairing(attr)) {
        reached("read", attr);
    }
    return true;
}

static bool on_write(struct bt_conn *conn, const struct bt_gatt_attr *attr)
{
    if ((bt_conn_get_security(conn) < BT_SECURITY_L4) && !in_zephyr_service(attr)) {
        reached("wrote", attr);
    }
    return true;
}

static const struct bt_gatt_authorization_cb checks = {
    .read_authorize = on_read,
    .write_authorize = on_write,
};

void paired_only_watch(void)
{
    if (bt_gatt_authorization_cb_register(&checks) != 0) {
        printk("the C-04 check didn't start\n");
        abort();
    }
}
```

## src/paired_only.h
```c
#ifndef PAIRED_ONLY_H
#define PAIRED_ONLY_H

/** Stops the fuzzer when a central below security level 4 reaches anything in the oximeter's
 * services but what it needs to find them and pair (C-04). */
void paired_only_watch(void);

#endif
```
